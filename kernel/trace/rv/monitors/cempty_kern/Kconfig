## kernel/trace/rv/monitors/cempty_kern/Kconfig
```kconfig
# SPDX-License-Identifier: GPL-2.0-only
#
config RV_MON_CEMPTY_KERN
	depends on RV
	# XXX: add dependencies if there
	select DA_MON_EVENTS_IMPLICIT
	bool "cempty_kern monitor"
	help
	  auto-generated
```

## kernel/trace/rv/monitors/csched_kern/Kconfig
```kconfig
# SPDX-License-Identifier: GPL-2.0-only
#
config RV_MON_CSCHED_KERN
	depends on RV
	# XXX: add dependencies if there
	select DA_MON_EVENTS_IMPLICIT
	bool "csched_kern monitor"
	help
	  auto-generated
```

## kernel/trace/rv/monitors/gsched_kern/Kconfig
```kconfig
# SPDX-License-Identifier: GPL-2.0-only
#
config RV_MON_GSCHED_KERN
	depends on RV
	# XXX: add dependencies if there
	select DA_MON_EVENTS_IMPLICIT
	bool "gsched_kern monitor"
	help
	  auto-generated
```

## kernel/trace/rv/monitors/tqueue_kern/Kconfig
```kconfig
# SPDX-License-Identifier: GPL-2.0-only
#
config RV_MON_TQUEUE_KERN
	depends on RV
	# XXX: add dependencies if there
	select DA_MON_EVENTS_ID
	bool "tqueue_kern monitor"
	help
	  auto-generated
```
